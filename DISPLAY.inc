INICIALIZA_LCD

	BCF		PORTE,0					;INICIALIZAÇÃO DO DISPLAY
	MOVLW	B'00111100'				;INICIALIZAÇÃO DO DISPLAY
	MOVWF	PORTD					;INICIALIZAÇÃO DO DISPLAY
	CALL	GERA_PULSO				;INICIALIZAÇÃO DO DISPLAY
	MOVLW	B'00111100'				;INICIALIZAÇÃO DO DISPLAY
	MOVWF	PORTD					;INICIALIZAÇÃO DO DISPLAY
	CALL	GERA_PULSO				;INICIALIZAÇÃO DO DISPLAY
	MOVLW	B'00111100'				;INICIALIZAÇÃO DO DISPLAY
	MOVWF	PORTD					;INICIALIZAÇÃO DO DISPLAY
	CALL	GERA_PULSO				;INICIALIZAÇÃO DO DISPLAY

	MOVLW	B'00001100'				;INICIALIZAÇÃO DO DISPLAY
	MOVWF	PORTD					;INICIALIZAÇÃO DO DISPLAY
	CALL	GERA_PULSO				;INICIALIZAÇÃO DO DISPLAY
	
	MOVLW	B'00000001'				;INICIALIZAÇÃO DO DISPLAY
	MOVWF	PORTD					;INICIALIZAÇÃO DO DISPLAY
	CALL	GERA_PULSO				;INICIALIZAÇÃO DO DISPLAY

	MOVLW	B'00000110'				;INICIALIZAÇÃO DO DISPLAY
	MOVWF	PORTD					;INICIALIZAÇÃO DO DISPLAY
	CALL	GERA_PULSO				;INICIALIZAÇÃO DO DISPLAY
	
	BSF		ESTADO_DISPLAY			;SETA A FLAG DE ESTADO A INICIALIZACAO DO DISPLAY

	;ESCREVE NA PRIMEIRA LINHA DO DISPLAY
	MOVLW	0x80					;P
	CALL	POSICIONA_DISPLAY
	MOVLW	'P'
	CALL	ESCREVE_DISPLAY

	MOVLW	0x81					;R
	CALL	POSICIONA_DISPLAY
	MOVLW	'R'
	CALL	ESCREVE_DISPLAY

	MOVLW	0x82					;O
	CALL	POSICIONA_DISPLAY
	MOVLW	'O'
	CALL	ESCREVE_DISPLAY

	MOVLW	0x83					;J
	CALL	POSICIONA_DISPLAY
	MOVLW	'J'
	CALL	ESCREVE_DISPLAY

	MOVLW	0x84					;E
	CALL	POSICIONA_DISPLAY
	MOVLW	'E'
	CALL	ESCREVE_DISPLAY

	MOVLW	0x85					;T
	CALL	POSICIONA_DISPLAY
	MOVLW	'T'
	CALL	ESCREVE_DISPLAY
	
	MOVLW	0x86					;O
	CALL	POSICIONA_DISPLAY
	MOVLW	'O'
	CALL	ESCREVE_DISPLAY


	MOVLW	0x87					;ESPAÇO
	CALL	POSICIONA_DISPLAY
	MOVLW	' '
	CALL	ESCREVE_DISPLAY
	

	MOVLW	0x88					;u
	CALL	POSICIONA_DISPLAY
	MOVLW	'u'
	CALL	ESCREVE_DISPLAY

	MOVLW	0x89					;C
	CALL	POSICIONA_DISPLAY
	MOVLW	'C'
	CALL	ESCREVE_DISPLAY

	;ESCREVE NA SEGUNDA LINHA DO DISPLAY
	MOVLW	0xC0					;G
	CALL	POSICIONA_DISPLAY
	MOVLW	'G'
	CALL	ESCREVE_DISPLAY

	MOVLW	0xC1					;A
	CALL	POSICIONA_DISPLAY
	MOVLW	'A'
	CALL	ESCREVE_DISPLAY

	MOVLW	0xC2					;B
	CALL	POSICIONA_DISPLAY
	MOVLW	'B'
	CALL	ESCREVE_DISPLAY
	
	MOVLW	0xC3					;R
	CALL	POSICIONA_DISPLAY
	MOVLW	'R'
	CALL	ESCREVE_DISPLAY

	MOVLW	0xC4					;I
	CALL	POSICIONA_DISPLAY
	MOVLW	'I'
	CALL	ESCREVE_DISPLAY

	MOVLW	0xC5					;E
	CALL	POSICIONA_DISPLAY
	MOVLW	'E'
	CALL	ESCREVE_DISPLAY

	MOVLW	0xC6					;L
	CALL	POSICIONA_DISPLAY
	MOVLW	'L'
	CALL	ESCREVE_DISPLAY


	MOVLW	0xC7					;ESPAÇO
	CALL	POSICIONA_DISPLAY
	MOVLW	' '
	CALL	ESCREVE_DISPLAY


	MOVLW	0xC8					;M
	CALL	POSICIONA_DISPLAY
	MOVLW	'M'
	CALL	ESCREVE_DISPLAY

	MOVLW	0xC9					;A
	CALL	POSICIONA_DISPLAY
	MOVLW	'A'
	CALL	ESCREVE_DISPLAY

	MOVLW	0xCA					;T
	CALL	POSICIONA_DISPLAY
	MOVLW	'T'
	CALL	ESCREVE_DISPLAY

	MOVLW	0xCB					;I
	CALL	POSICIONA_DISPLAY
	MOVLW	'I'
	CALL	ESCREVE_DISPLAY

	MOVLW	0xCC					;A
	CALL	POSICIONA_DISPLAY
	MOVLW	'A'
	CALL	ESCREVE_DISPLAY
	
	MOVLW	0xCD					;S
	CALL	POSICIONA_DISPLAY
	MOVLW	'S'
	CALL	ESCREVE_DISPLAY
	
	RETURN							;RETORNO

CAIXA_LIVRE
	
	MOVLW	B'00000001'				;LIMPA DISPLAY
	CALL	POSICIONA_DISPLAY

	;ESCREVE NA PRIMEIRA LINHA DO DISPLAY
	MOVLW	0x80					;A
	CALL	POSICIONA_DISPLAY
	MOVLW	'A'
	CALL	ESCREVE_DISPLAY

	MOVLW	0x81					;T
	CALL	POSICIONA_DISPLAY
	MOVLW	'T'
	CALL	ESCREVE_DISPLAY

	MOVLW	0x82					;E
	CALL	POSICIONA_DISPLAY
	MOVLW	'E'
	CALL	ESCREVE_DISPLAY
	
	MOVLW	0x83					;N
	CALL	POSICIONA_DISPLAY
	MOVLW	'N'
	CALL	ESCREVE_DISPLAY
	
	MOVLW	0x84					;C
	CALL	POSICIONA_DISPLAY
	MOVLW	'C'
	CALL	ESCREVE_DISPLAY
	
	MOVLW	0x85					;A
	CALL	POSICIONA_DISPLAY
	MOVLW	'A'
	CALL	ESCREVE_DISPLAY
	
	MOVLW	0x86					;O
	CALL	POSICIONA_DISPLAY
	MOVLW	'O'
	CALL	ESCREVE_DISPLAY


	;ESCREVE NA SEGUNDA LINHA DO DISPLAY
	MOVLW	0xC0					;C
	CALL	POSICIONA_DISPLAY
	MOVLW	'C'
	CALL	ESCREVE_DISPLAY

	MOVLW	0xC1					;A
	CALL	POSICIONA_DISPLAY
	MOVLW	'A'
	CALL	ESCREVE_DISPLAY

	MOVLW	0xC2					;I
	CALL	POSICIONA_DISPLAY
	MOVLW	'I'
	CALL	ESCREVE_DISPLAY
	
	MOVLW	0xC3					;X
	CALL	POSICIONA_DISPLAY
	MOVLW	'X'
	CALL	ESCREVE_DISPLAY

	MOVLW	0xC4					;A
	CALL	POSICIONA_DISPLAY
	MOVLW	'A'
	CALL	ESCREVE_DISPLAY


	MOVLW	0xC5					;ESPAÇO
	CALL	POSICIONA_DISPLAY
	MOVLW	' '
	CALL	ESCREVE_DISPLAY


	MOVLW	0xC6					;ESCREVE O VALOR DO CAIXA
	CALL	POSICIONA_DISPLAY
	MOVF	CAIXA,W
	CALL	ESCREVE_DISPLAY


	MOVLW	0xC7					;ESPAÇO
	CALL	POSICIONA_DISPLAY
	MOVLW	' '
	CALL	ESCREVE_DISPLAY


	MOVLW	0xC8					;L
	CALL	POSICIONA_DISPLAY
	MOVLW	'L'
	CALL	ESCREVE_DISPLAY

	MOVLW	0xC9					;I
	CALL	POSICIONA_DISPLAY
	MOVLW	'I'
	CALL	ESCREVE_DISPLAY

	MOVLW	0xCA					;V
	CALL	POSICIONA_DISPLAY
	MOVLW	'V'
	CALL	ESCREVE_DISPLAY

	MOVLW	0xCB					;R
	CALL	POSICIONA_DISPLAY
	MOVLW	'R'
	CALL	ESCREVE_DISPLAY

	MOVLW	0xCC					;E
	CALL	POSICIONA_DISPLAY
	MOVLW	'E'
	CALL	ESCREVE_DISPLAY

	RETURN							;RETORNA

CAIXA_FIM
	
	MOVLW	B'00000001'				;LIMPA DISPLAY
	CALL	POSICIONA_DISPLAY

	;ESCREVE NA PRIMEIRA LINHA DO DISPLAY
	MOVLW	0x80					;C
	CALL	POSICIONA_DISPLAY
	MOVLW	'C'
	CALL	ESCREVE_DISPLAY

	MOVLW	0x81					;A
	CALL	POSICIONA_DISPLAY
	MOVLW	'A'
	CALL	ESCREVE_DISPLAY

	MOVLW	0x82					;I
	CALL	POSICIONA_DISPLAY
	MOVLW	'I'
	CALL	ESCREVE_DISPLAY
	
	MOVLW	0x83					;X
	CALL	POSICIONA_DISPLAY
	MOVLW	'X'
	CALL	ESCREVE_DISPLAY
	
	MOVLW	0x84					;A
	CALL	POSICIONA_DISPLAY
	MOVLW	'A'
	CALL	ESCREVE_DISPLAY
	

	MOVLW	0x85					;ESPAÇO
	CALL	POSICIONA_DISPLAY
	MOVLW	' '
	CALL	ESCREVE_DISPLAY
	

	MOVLW	0x86					;ESCREVE O VALOR DO CAIXA NO DISPLAY
	CALL	POSICIONA_DISPLAY
	MOVF	CAIXA,W
	CALL	ESCREVE_DISPLAY


	;ESCREVE NA SEGUNDA LINHA DO DISPLAY
	MOVLW	0xC0					;F
	CALL	POSICIONA_DISPLAY
	MOVLW	'F'
	CALL	ESCREVE_DISPLAY

	MOVLW	0xC1					;I
	CALL	POSICIONA_DISPLAY
	MOVLW	'I'
	CALL	ESCREVE_DISPLAY

	MOVLW	0xC2					;N
	CALL	POSICIONA_DISPLAY
	MOVLW	'N'
	CALL	ESCREVE_DISPLAY
	
	MOVLW	0xC3					;A
	CALL	POSICIONA_DISPLAY
	MOVLW	'A'
	CALL	ESCREVE_DISPLAY

	MOVLW	0xC4					;L
	CALL	POSICIONA_DISPLAY
	MOVLW	'L'
	CALL	ESCREVE_DISPLAY

	MOVLW	0xC5					;I
	CALL	POSICIONA_DISPLAY
	MOVLW	'I'
	CALL	ESCREVE_DISPLAY

	MOVLW	0xC6					;Z
	CALL	POSICIONA_DISPLAY
	MOVLW	'Z'
	CALL	ESCREVE_DISPLAY

	MOVLW	0xC7					;A
	CALL	POSICIONA_DISPLAY
	MOVLW	'A'
	CALL	ESCREVE_DISPLAY

	MOVLW	0xC8					;D
	CALL	POSICIONA_DISPLAY
	MOVLW	'D'
	CALL	ESCREVE_DISPLAY

	MOVLW	0xC9					;O
	CALL	POSICIONA_DISPLAY
	MOVLW	'O'
	CALL	ESCREVE_DISPLAY

	RETURN							;RETORNA

MOSTRAR_CONTADOR
	
	MOVLW	B'00000001'				;LIMPA DISPLAY
	CALL	POSICIONA_DISPLAY

	;ESCREVE NA PRIMEIRA LINHA DO DISPLAY
	MOVLW	0x80					;A
	CALL	POSICIONA_DISPLAY		
	MOVLW	'A'
	CALL	ESCREVE_DISPLAY

	MOVLW	0x81					;T
	CALL	POSICIONA_DISPLAY		
	MOVLW	'T'
	CALL	ESCREVE_DISPLAY

	MOVLW	0x82					;E
	CALL	POSICIONA_DISPLAY
	MOVLW	'E'
	CALL	ESCREVE_DISPLAY
	
	MOVLW	0x83					;N
	CALL	POSICIONA_DISPLAY
	MOVLW	'N'
	CALL	ESCREVE_DISPLAY
	
	MOVLW	0x84					;D
	CALL	POSICIONA_DISPLAY
	MOVLW	'D'
	CALL	ESCREVE_DISPLAY
	
	MOVLW	0x85					;I
	CALL	POSICIONA_DISPLAY
	MOVLW	'I'
	CALL	ESCREVE_DISPLAY
	
	MOVLW	0x86					;M
	CALL	POSICIONA_DISPLAY
	MOVLW	'M'
	CALL	ESCREVE_DISPLAY

	MOVLW	0x87					;E
	CALL	POSICIONA_DISPLAY
	MOVLW	'E'
	CALL	ESCREVE_DISPLAY

	MOVLW	0x88					;N
	CALL	POSICIONA_DISPLAY
	MOVLW	'N'
	CALL	ESCREVE_DISPLAY

	MOVLW	0x89					;T
	CALL	POSICIONA_DISPLAY
	MOVLW	'T'
	CALL	ESCREVE_DISPLAY

	MOVLW	0x8A					;O
	CALL	POSICIONA_DISPLAY
	MOVLW	'O'
	CALL	ESCREVE_DISPLAY

	MOVLW	0x8B					;S
	CALL	POSICIONA_DISPLAY
	MOVLW	'S'
	CALL	ESCREVE_DISPLAY

	MOVLW	0x8C					;:
	CALL	POSICIONA_DISPLAY
	MOVLW	':'
	CALL	ESCREVE_DISPLAY


	;ESCREVE NA SEGUNDA LINHA DO DISPLAY
	MOVLW	0xC0					;ESCREVE O VALOR DA VARIAVEL DIGITO1
	CALL	POSICIONA_DISPLAY
	MOVF	DIGITO1,W
	CALL	ESCREVE_DISPLAY

	MOVLW	0xC1					;ESCREVE O VALOR DA VARIAVEL DIGITO2
	CALL	POSICIONA_DISPLAY
	MOVF	DIGITO2,W
	CALL	ESCREVE_DISPLAY

	MOVLW	0xC2					;ESCREVE O VALOR DA VARIAVEL DIGITO3
	CALL	POSICIONA_DISPLAY
	MOVF	DIGITO3,W
	CALL	ESCREVE_DISPLAY
	

	MOVLW	0xC3					;ESPAÇO
	CALL	POSICIONA_DISPLAY
	MOVLW	' '
	CALL	ESCREVE_DISPLAY


	MOVLW	0xC4					;P
	CALL	POSICIONA_DISPLAY
	MOVLW	'P'
	CALL	ESCREVE_DISPLAY

	MOVLW	0xC5					;E
	CALL	POSICIONA_DISPLAY
	MOVLW	'E'
	CALL	ESCREVE_DISPLAY

	MOVLW	0xC6					;S
	CALL	POSICIONA_DISPLAY
	MOVLW	'S'
	CALL	ESCREVE_DISPLAY

	MOVLW	0xC7					;S
	CALL	POSICIONA_DISPLAY
	MOVLW	'S'
	CALL	ESCREVE_DISPLAY

	MOVLW	0xC8					;O
	CALL	POSICIONA_DISPLAY
	MOVLW	'O'
	CALL	ESCREVE_DISPLAY

	MOVLW	0xC9					;A
	CALL	POSICIONA_DISPLAY
	MOVLW	'A'
	CALL	ESCREVE_DISPLAY

	MOVLW	0xCA					;S
	CALL	POSICIONA_DISPLAY
	MOVLW	'S'
	CALL	ESCREVE_DISPLAY

	RETURN							;RETORNA


MOSTRAR_ENDERECO

	MOVLW	B'00000001'				;LIMPA DISPLAY
	CALL	POSICIONA_DISPLAY

	;ESCREVE NA PRIMEIRA LINHA DO DISPLAY
	MOVLW	0x80					;E
	CALL	POSICIONA_DISPLAY		
	MOVLW	'E'
	CALL	ESCREVE_DISPLAY

	MOVLW	0x81					;N
	CALL	POSICIONA_DISPLAY		
	MOVLW	'N'
	CALL	ESCREVE_DISPLAY

	MOVLW	0x82					;D
	CALL	POSICIONA_DISPLAY
	MOVLW	'D'
	CALL	ESCREVE_DISPLAY
	
	MOVLW	0x83					;E
	CALL	POSICIONA_DISPLAY
	MOVLW	'E'
	CALL	ESCREVE_DISPLAY
	
	MOVLW	0x84					;R
	CALL	POSICIONA_DISPLAY
	MOVLW	'R'
	CALL	ESCREVE_DISPLAY
	
	MOVLW	0x85					;E
	CALL	POSICIONA_DISPLAY
	MOVLW	'E'
	CALL	ESCREVE_DISPLAY
	
	MOVLW	0x86					;Ç
	CALL	POSICIONA_DISPLAY
	MOVLW	'C'
	CALL	ESCREVE_DISPLAY

	MOVLW	0x87					;O
	CALL	POSICIONA_DISPLAY
	MOVLW	'O'
	CALL	ESCREVE_DISPLAY

	MOVLW	0x88					;:
	CALL	POSICIONA_DISPLAY
	MOVLW	':'
	CALL	ESCREVE_DISPLAY

	MOVLW	0x89					;0
	CALL	POSICIONA_DISPLAY
	MOVLW	'0'
	CALL	ESCREVE_DISPLAY

	MOVLW	0x8A					;x
	CALL	POSICIONA_DISPLAY
	MOVLW	'x'
	CALL	ESCREVE_DISPLAY

	MOVF	ENDERECO,W				;MOVE O VALOR DE DADO PARA W
	MOVWF	DIGEND1					;COPIA W PARA A VARIAVEL
	MOVWF	DIGEND2					;COPIA W PARA A VARIAVEL
	
	MOVLW	0xF0					;MOVE 0xF0 PARA W
	ANDWF	DIGEND1,F				;REALIZA A OPERACAO AND ENTRE W E DIGEND1
	SWAPF	DIGEND1,F				;INVERTE OS NIBBLES DA VARIAVEL DIGEND1
	
	MOVLW	0x0F					;MOVE 0x0F PARA W
	ANDWF	DIGEND2,F				;REALIZA A OPERACAO AND ENTRE W E DIGEND2

	MOVLW	0x30					;MOVE ESSE VALOR PARA W P/ ESCRITA NA ASCII
	ADDWF	DIGEND1,F				;ADICIONA W EM DIGEND1
	ADDWF	DIGEND2,F				;ADICIONA W EM DIGEND2

	MOVLW	0x8B					;PASSA ESSE VALOR PARA W
	CALL	POSICIONA_DISPLAY		;MOVE O CURSOR DO DISPLAY PARA ESSA POSICAO
	MOVF	DIGEND1,W				;COPIA O VALOR DE DIGDADO1 PARA W
	CALL	ESCREVE_DISPLAY			;ESCREVE O VALOR NO DISPLAY
	
	MOVLW	0x8C
	CALL	POSICIONA_DISPLAY		;MOVE O CURSOR DO DISPLAY PARA ESSA POSICAO
	MOVF	DIGEND2,W
	CALL	ESCREVE_DISPLAY			;ESCREVE O VALOR NO DISPLAY


	;ESCREVE NA SEGUNDA LINHA DO DISPLAY
	MOVLW	0xC0					;S
	CALL	POSICIONA_DISPLAY
	MOVLW	'S'	
	CALL	ESCREVE_DISPLAY

	MOVLW	0xC1					;A
	CALL	POSICIONA_DISPLAY
	MOVLW	'A'
	CALL	ESCREVE_DISPLAY

	MOVLW	0xC2					;L
	CALL	POSICIONA_DISPLAY
	MOVLW	'L'
	CALL	ESCREVE_DISPLAY
	
	MOVLW	0xC3					;V
	CALL	POSICIONA_DISPLAY
	MOVLW	'V'
	CALL	ESCREVE_DISPLAY

	MOVLW	0xC4					;A
	CALL	POSICIONA_DISPLAY
	MOVLW	'A'
	CALL	ESCREVE_DISPLAY

	MOVLW	0xC5					;R
	CALL	POSICIONA_DISPLAY
	MOVLW	'R'
	CALL	ESCREVE_DISPLAY


	MOVLW	0xC6					;ESPAÇO
	CALL	POSICIONA_DISPLAY
	MOVLW	' '
	CALL	ESCREVE_DISPLAY


	MOVLW	0xC7					;O
	CALL	POSICIONA_DISPLAY
	MOVLW	'O'
	CALL	ESCREVE_DISPLAY

	MOVLW	0xC8					;U
	CALL	POSICIONA_DISPLAY
	MOVLW	'U'
	CALL	ESCREVE_DISPLAY


	MOVLW	0xC9					;ESPAÇO
	CALL	POSICIONA_DISPLAY
	MOVLW	' '
	CALL	ESCREVE_DISPLAY


	MOVLW	0xCA					;L
	CALL	POSICIONA_DISPLAY
	MOVLW	'L'
	CALL	ESCREVE_DISPLAY

	MOVLW	0xCB					;E
	CALL	POSICIONA_DISPLAY
	MOVLW	'E'
	CALL	ESCREVE_DISPLAY
	
	MOVLW	0xCC					;R
	CALL	POSICIONA_DISPLAY
	MOVLW	'R'
	CALL	ESCREVE_DISPLAY

	MOVLW	0xCD					;?
	CALL	POSICIONA_DISPLAY
	MOVLW	'?'
	CALL	ESCREVE_DISPLAY

	RETURN							;RETORNA

FIM_ESCRITA

	MOVLW	B'00000001'				;LIMPA DISPLAY
	CALL	POSICIONA_DISPLAY

	;ESCREVE NA PRIMEIRA LINHA DO DISPLAY
	MOVLW	0x80					;S
	CALL	POSICIONA_DISPLAY		
	MOVLW	'S'
	CALL	ESCREVE_DISPLAY

	MOVLW	0x81					;A
	CALL	POSICIONA_DISPLAY		
	MOVLW	'A'
	CALL	ESCREVE_DISPLAY

	MOVLW	0x82					;L
	CALL	POSICIONA_DISPLAY
	MOVLW	'L'
	CALL	ESCREVE_DISPLAY
	
	MOVLW	0x83					;V
	CALL	POSICIONA_DISPLAY
	MOVLW	'V'
	CALL	ESCREVE_DISPLAY
	
	MOVLW	0x84					;O
	CALL	POSICIONA_DISPLAY
	MOVLW	'O'
	CALL	ESCREVE_DISPLAY

	MOVLW	0x85					;!
	CALL	POSICIONA_DISPLAY
	MOVLW	'!'
	CALL	ESCREVE_DISPLAY

	RETURN							;RETORNA

MOSTRAR_V33
	
	MOVLW	B'00000001'				;LIMPA DISPLAY
	CALL	POSICIONA_DISPLAY

	;ESCREVE NA PRIMEIRA LINHA DO DISPLAY
	MOVLW	0x80					;M
	CALL	POSICIONA_DISPLAY		
	MOVLW	'M'
	CALL	ESCREVE_DISPLAY

	MOVLW	0x81					;O
	CALL	POSICIONA_DISPLAY		
	MOVLW	'O'
	CALL	ESCREVE_DISPLAY

	MOVLW	0x82					;T
	CALL	POSICIONA_DISPLAY
	MOVLW	'T'
	CALL	ESCREVE_DISPLAY
	
	MOVLW	0x83					;O
	CALL	POSICIONA_DISPLAY
	MOVLW	'O'
	CALL	ESCREVE_DISPLAY
	
	MOVLW	0x84					;R
	CALL	POSICIONA_DISPLAY
	MOVLW	'R'
	CALL	ESCREVE_DISPLAY
	

	MOVLW	0x85					;ESPAÇO
	CALL	POSICIONA_DISPLAY
	MOVLW	' '
	CALL	ESCREVE_DISPLAY

	
	MOVLW	0x86					;E
	CALL	POSICIONA_DISPLAY
	MOVLW	'E'
	CALL	ESCREVE_DISPLAY

	MOVLW	0x87					;M
	CALL	POSICIONA_DISPLAY
	MOVLW	'M'
	CALL	ESCREVE_DISPLAY


	MOVLW	0x88					;ESPAÇO
	CALL	POSICIONA_DISPLAY
	MOVLW	' '
	CALL	ESCREVE_DISPLAY


	MOVLW	0x89					;3
	CALL	POSICIONA_DISPLAY
	MOVLW	'3'
	CALL	ESCREVE_DISPLAY

	MOVLW	0x8A					;3
	CALL	POSICIONA_DISPLAY
	MOVLW	'3'
	CALL	ESCREVE_DISPLAY

	MOVLW	0x8B					;%
	CALL	POSICIONA_DISPLAY
	MOVLW	'%'
	CALL	ESCREVE_DISPLAY

	RETURN							;RETORNA

MOSTRAR_V100
	
	MOVLW	B'00000001'				;LIMPA DISPLAY
	CALL	POSICIONA_DISPLAY

	;ESCREVE NA PRIMEIRA LINHA DO DISPLAY
	MOVLW	0x80					;M
	CALL	POSICIONA_DISPLAY		
	MOVLW	'M'
	CALL	ESCREVE_DISPLAY

	MOVLW	0x81					;O
	CALL	POSICIONA_DISPLAY		
	MOVLW	'O'
	CALL	ESCREVE_DISPLAY

	MOVLW	0x82					;T
	CALL	POSICIONA_DISPLAY
	MOVLW	'T'
	CALL	ESCREVE_DISPLAY
	
	MOVLW	0x83					;O
	CALL	POSICIONA_DISPLAY
	MOVLW	'O'
	CALL	ESCREVE_DISPLAY
	
	MOVLW	0x84					;R
	CALL	POSICIONA_DISPLAY
	MOVLW	'R'
	CALL	ESCREVE_DISPLAY
	

	MOVLW	0x85					;ESPAÇO
	CALL	POSICIONA_DISPLAY
	MOVLW	' '
	CALL	ESCREVE_DISPLAY

	
	MOVLW	0x86					;E
	CALL	POSICIONA_DISPLAY
	MOVLW	'E'
	CALL	ESCREVE_DISPLAY

	MOVLW	0x87					;M
	CALL	POSICIONA_DISPLAY
	MOVLW	'M'
	CALL	ESCREVE_DISPLAY


	MOVLW	0x88					;ESPAÇO
	CALL	POSICIONA_DISPLAY
	MOVLW	' '
	CALL	ESCREVE_DISPLAY


	MOVLW	0x89					;1
	CALL	POSICIONA_DISPLAY
	MOVLW	'1'
	CALL	ESCREVE_DISPLAY

	MOVLW	0x8A					;0
	CALL	POSICIONA_DISPLAY
	MOVLW	'0'
	CALL	ESCREVE_DISPLAY

	MOVLW	0x8B					;0
	CALL	POSICIONA_DISPLAY
	MOVLW	'0'
	CALL	ESCREVE_DISPLAY

	MOVLW	0x8C					;%
	CALL	POSICIONA_DISPLAY
	MOVLW	'%'
	CALL	ESCREVE_DISPLAY

	RETURN							;RETORNA

MOSTRAR_MEDIA_3CASAS
	
	MOVLW	B'00000001'				;LIMPA DISPLAY
	CALL	POSICIONA_DISPLAY
	BSF		FIM_MEDIA				;SETA A FLAG FIM_MEDIA

	;ESCREVE NA PRIMEIRA LINHA DO DISPLAY
	MOVLW	0x80					;M
	CALL	POSICIONA_DISPLAY		
	MOVLW	'M'
	CALL	ESCREVE_DISPLAY

	MOVLW	0x81					;E
	CALL	POSICIONA_DISPLAY		
	MOVLW	'E'
	CALL	ESCREVE_DISPLAY

	MOVLW	0x82					;D
	CALL	POSICIONA_DISPLAY
	MOVLW	'D'
	CALL	ESCREVE_DISPLAY
	
	MOVLW	0x83					;I
	CALL	POSICIONA_DISPLAY
	MOVLW	'I'
	CALL	ESCREVE_DISPLAY
	
	MOVLW	0x84					;A
	CALL	POSICIONA_DISPLAY
	MOVLW	'A'
	CALL	ESCREVE_DISPLAY
	
	MOVLW	0x85					;:
	CALL	POSICIONA_DISPLAY
	MOVLW	':'
	CALL	ESCREVE_DISPLAY

	
	MOVLW	0x86					;ESCREVE O VALOR DA VARIAVEL DIGITO1
	CALL	POSICIONA_DISPLAY
	MOVLW	0x30			
	ADDWF	DIGITO1,F				;DEIXA EM ASCII
	MOVF	DIGITO1,W
	CALL	ESCREVE_DISPLAY

	MOVLW	0x87					;ESCREVE O VALOR DA VARIAVEL DIGITO2
	CALL	POSICIONA_DISPLAY
	MOVLW	0x30			
	ADDWF	DIGITO2,F				;DEIXA EM ASCII
	MOVF	DIGITO2,W
	CALL	ESCREVE_DISPLAY


	MOVLW	0x88					;ESCREVE O VALOR DA VARIAVEL DIGITO3
	CALL	POSICIONA_DISPLAY
	MOVLW	0x30			
	ADDWF	DIGITO3,F				;DEIXA EM ASCII
	MOVF	DIGITO3,W
	CALL	ESCREVE_DISPLAY

	BTFSC	RESTO_0					;TESTA A FLAG RESTO_0
	RETURN							;RETORNA

	MOVLW	0x89					;,
	CALL	POSICIONA_DISPLAY
	MOVLW	','
	CALL	ESCREVE_DISPLAY

	MOVLW	0x8A					;ESCREVE O VALOR DA VARIAVEL MEDIA_RESTO	
	CALL	POSICIONA_DISPLAY
	MOVLW	0x30
	ADDWF	MEDIA_RESTO				;DEIXA EM ASCII
	MOVF	MEDIA_RESTO,W
	CALL	ESCREVE_DISPLAY

	RETURN							;RETORNA

MOSTRAR_MEDIA_2CASAS
	
	MOVLW	B'00000001'				;LIMPA DISPLAY
	CALL	POSICIONA_DISPLAY
	BSF		FIM_MEDIA				;SETA A FLAG DE FIM_MEDIA

	;ESCREVE NA PRIMEIRA LINHA DO DISPLAY
	MOVLW	0x80					;M
	CALL	POSICIONA_DISPLAY		
	MOVLW	'M'
	CALL	ESCREVE_DISPLAY

	MOVLW	0x81					;E
	CALL	POSICIONA_DISPLAY		
	MOVLW	'E'
	CALL	ESCREVE_DISPLAY

	MOVLW	0x82					;D
	CALL	POSICIONA_DISPLAY
	MOVLW	'D'
	CALL	ESCREVE_DISPLAY
	
	MOVLW	0x83					;I
	CALL	POSICIONA_DISPLAY
	MOVLW	'I'
	CALL	ESCREVE_DISPLAY
	
	MOVLW	0x84					;A
	CALL	POSICIONA_DISPLAY
	MOVLW	'A'
	CALL	ESCREVE_DISPLAY
	
	MOVLW	0x85					;:
	CALL	POSICIONA_DISPLAY
	MOVLW	':'
	CALL	ESCREVE_DISPLAY

	
	MOVLW	0x86					;ESCREVE O VALOR DA VARIAVEL DIGITO2
	CALL	POSICIONA_DISPLAY
	MOVLW	0x30			
	ADDWF	DIGITO2,F				;DEIXA EM ASCII
	MOVF	DIGITO2,W
	CALL	ESCREVE_DISPLAY

	MOVLW	0x87					;ESCREVE O VALOR DA VARIAVEL DIGITO3
	CALL	POSICIONA_DISPLAY
	MOVLW	0x30			
	ADDWF	DIGITO3,F				;DEIXA EM ASCII
	MOVF	DIGITO3,W
	CALL	ESCREVE_DISPLAY

	BTFSC	RESTO_0					;TESTA A FLAG SE EXISTE VALOR DECIMAL
	RETURN							;RETORNA

	MOVLW	0x88					;,
	CALL	POSICIONA_DISPLAY
	MOVLW	','
	CALL	ESCREVE_DISPLAY

	MOVLW	0x89					;ESCREVE O VALOR DA VARIAVEL MEDIA_RESTO
	CALL	POSICIONA_DISPLAY
	MOVLW	0x30
	ADDWF	MEDIA_RESTO				;DEIXA EM ASCII
	MOVF	MEDIA_RESTO,W
	CALL	ESCREVE_DISPLAY

	RETURN							;RETORNA

MOSTRAR_MEDIA_1CASA
	
	MOVLW	B'00000001'				;LIMPA DISPLAY
	CALL	POSICIONA_DISPLAY
	BSF		FIM_MEDIA				;SETA A FLAG DE FIM_MEDIA

	;ESCREVE NA PRIMEIRA LINHA DO DISPLAY
	MOVLW	0x80					;M
	CALL	POSICIONA_DISPLAY		
	MOVLW	'M'
	CALL	ESCREVE_DISPLAY

	MOVLW	0x81					;E
	CALL	POSICIONA_DISPLAY		
	MOVLW	'E'
	CALL	ESCREVE_DISPLAY

	MOVLW	0x82					;D
	CALL	POSICIONA_DISPLAY
	MOVLW	'D'
	CALL	ESCREVE_DISPLAY
	
	MOVLW	0x83					;I
	CALL	POSICIONA_DISPLAY
	MOVLW	'I'
	CALL	ESCREVE_DISPLAY
	
	MOVLW	0x84					;A
	CALL	POSICIONA_DISPLAY
	MOVLW	'A'
	CALL	ESCREVE_DISPLAY
	
	MOVLW	0x85					;:
	CALL	POSICIONA_DISPLAY
	MOVLW	':'
	CALL	ESCREVE_DISPLAY

	
	MOVLW	0x86					;ESCREVE O VALOR DA VARIAVEL DIGITO3
	CALL	POSICIONA_DISPLAY
	MOVLW	0x30			
	ADDWF	DIGITO3,F				;DEIXA EM ASCII
	MOVF	DIGITO3,W
	CALL	ESCREVE_DISPLAY

	BTFSC	RESTO_0					;TESTA A FLAG SE EXISTE VALOR DECIMAL
	RETURN							;RETORNA

	MOVLW	0x87					;,
	CALL	POSICIONA_DISPLAY
	MOVLW	','
	CALL	ESCREVE_DISPLAY


	MOVLW	0x88					;ESCREVE O VALOR DA VARIAVEL MEDIA_RESTO
	CALL	POSICIONA_DISPLAY
	MOVLW	0x30
	ADDWF	MEDIA_RESTO				;DEIXA EM ASCII
	MOVF	MEDIA_RESTO,W
	CALL	ESCREVE_DISPLAY

	RETURN							;RETORNA

DIGITOS

	MOVF	BATATA,W				;MOVE CONTADOR PARA W
	MOVWF	DIVIDENDO				;MOVE W PARA DIVIDENDO
	MOVLW	B'01100100'				;DECIMAL 100 EM BINARIO
	MOVWF	DIVISOR					;MOVE 100 PARA DIVIDOR PARA OBTER O PRIMEIRO DIGITO
	CALL	DIVIDE_8x8				;CHAMA A ROTINA DE DIVISÃO

	MOVF	QUOCIENTE,W				;MOVE O RESULTADO PARA W
	MOVWF	DIGITO1					;MOVE W PARA DIGITO1
	;MOVLW	0x30			
	;ADDWF	DIGITO1,F				;DEIXA EM ASCII

	MOVF	RESTO,W					;MOVE O RESTO PARA W
	MOVWF	DIVIDENDO				;MOVE W PARA DIVIDENDO
	MOVLW	B'00001010'				;DECIMAL 10 EM BINARIO
	MOVWF	DIVISOR					;MOVE 10 PARA DIVIDOR PARA OBTER O SEGUNDO DIGITO
	CALL	DIVIDE_8x8				;CHAMA A ROTINA DE DIVISÃO

	MOVF	QUOCIENTE,W				;MOVE O RESULTADO PARA W
	MOVWF	DIGITO2					;MOVE W PARA DIGITO2
	;MOVLW	0x30			
	;ADDWF	DIGITO2,F				;DEIXA EM ASCII

	MOVF	RESTO,W					;MOVE O RESTO PARA W
	MOVWF	DIGITO3					;MOVE W PARA DIGITO3
	;MOVLW	0x30							
	;ADDWF	DIGITO3,F				;DEIXA EM ASCII

	RETURN							;RETORNA

POSICIONA_DISPLAY

	BCF		PORTE,0					;ENTRA NO MODO INSTRUÇÃO DO DISPLAY
	MOVWF	PORTD
	CALL	GERA_PULSO
	
	RETURN

ESCREVE_DISPLAY
	
	BSF		PORTE,0					;ENTRA NO MODO ESCRITA DO DISPLAY
	MOVWF	PORTD
	CALL	GERA_PULSO
	
	RETURN

GERA_PULSO
	
	BSF		PORTE,1					;GERA PULSO PARA ESCRITA OU INSTRUÇÃO
	CALL	FILTRO					;NO DISPLAY
	CALL	FILTRO
	BCF		PORTE,1

	RETURN