TECLADO

	MOVLW	B'11111110'		;PASSA ESSE VALOR BINARIO PARA O REGISTRADOR W+
	MOVWF	PORTC			;MOVE O VALOR DE W PARA O PORTC, HABILITANDO APENAS O C0
	CALL	PORT_C0			;CHAMA A ROTINA PORT_C0

	MOVLW	B'11111011'		;PASSA ESSE VALOR BINARIO PARA O REGISTRADOR W
	MOVWF	PORTC			;MOVE O VALOR DE W PARA O PORTC, HABILITANDO APENAS O C2
	CALL	PORT_C2			;CHAMA A ROTINA PORT_C2

	MOVLW	B'11110111'		;PASSA ESSE VALOR BINARIO PARA O REGISTRADOR W
	MOVWF	PORTC			;MOVE O VALOR DE W PARA O PORTC, HABILITANDO APENAS O C3
	CALL	PORT_C3			;CHAMA A ROTINA PORT_C3

	GOTO	MAIN			;RETORNA PARA O MAIN

PORT_C0

	BTFSS	PORTB,0			;TESTA O PORTB0, SE ESTIVER APERTADO CHAMA A ROTINA TECLA_0
	CALL	TECLA_0			;CHAMA A ROTINA TECLA_0
	BTFSS	PORTB,1			;TESTA O PORTB1, SE ESTIVER APERTADO CHAMA A ROTINA TECLA_1
	CALL	TECLA_1			;CHAMA A ROTINA TECLA_1
	BTFSS	PORTB,2			;TESTA O PORTB2, SE ESTIVER APERTADO CHAMA A ROTINA TECLA_2
	CALL	TECLA_2			;CHAMA A ROTINA TECLA_2
	BTFSS	PORTB,3			;TESTA O PORTB3, SE ESTIVER APERTADO CHAMA A ROTINA TECLA_3
	CALL	TECLA_3			;CHAMA A ROTINA TECLA_3
	
	RETURN					;RETORNA PARA A ROTINA TECLADO

PORT_C2

	BTFSS	PORTB,0			;TESTA O PORTB0, SE ESTIVER APERTADO CHAMA A ROTINA TECLA_8
	CALL	TECLA_8			;CHAMA A ROTINA TECLA_8
	BTFSS	PORTB,1			;TESTA O PORTB1, SE ESTIVER APERTADO CHAMA A ROTINA TECLA_9
	CALL	TECLA_9			;CHAMA A ROTINA TECLA_9
	BTFSS	PORTB,2			;TESTA O PORTB2, SE ESTIVER APERTADO CHAMA A ROTINA TECLA_A
	CALL	TECLA_A			;CHAMA A ROTINA TECLA_A
	BTFSS	PORTB,3			;TESTA O PORTB3, SE ESTIVER APERTADO CHAMA A ROTINA TECLA_B
	CALL	TECLA_B			;CHAMA A ROTINA TECLA_B
	
	RETURN					;RETORNA PARA A ROTINA TECLADO

PORT_C3

	BTFSS	PORTB,0			;TESTA O PORTB0, SE ESTIVER APERTADO CHAMA A ROTINA TECLA_C
	CALL	TECLA_C			;CHAMA A ROTINA TECLA_C
	BTFSS	PORTB,1			;TESTA O PORTB1, SE ESTIVER APERTADO CHAMA A ROTINA TECLA_D
	CALL	TECLA_D			;CHAMA A ROTINA TECLA_D
	BTFSS	PORTB,2			;TESTA O PORTB2, SE ESTIVER APERTADO CHAMA A ROTINA TECLA_E
	CALL	TECLA_E			;CHAMA A ROTINA TECLA_E
	BTFSS	PORTB,3			;TESTA O PORTB3, SE ESTIVER APERTADO CHAMA A ROTINA TECLA_F
	CALL	TECLA_F			;CHAMA A ROTINA TECLA_F
	
	RETURN					;RETORNA PARA A ROTINA TECLADO


TECLA_0

	BTFSC	PORTB,0			;TESTA SE O BIT 0 DO PORTB ESTA COM VALOR 0
	RETURN					;RETORNA PARA A ROTINA PORT_C0
	CALL	FILTRO			;CHAMA A ROTINA FILTRO (DELAY)
	BTFSC	PORTB,0			;TESTA SE O BIT 0 DO PORTB ESTA COM VALOR 0
	RETURN					;RETORNA PARA A ROTINA PORT_C0
	CALL	FILTRO			;CHAMA A ROTINA FILTRO (DELAY)
	BTFSC	PORTB,0			;TESTA SE O BIT 0 DO PORTB ESTA COM VALOR 0
	RETURN					;RETORNA PARA A ROTINA PORT_C0
	BTFSS	PORTB,0			;VERIFICA SE O BOTAO FOI SOLTO
	GOTO	$-1				;EXECUTA A LINHA ANTERIOR NOVAMENTE
	
	BTFSC	ESTADO_MOTOR	;TRAVA DE MOTOR LIGADO
	RETURN

	BSF		PORTA,2			;LIGA O BUZZER
	BSF		ESTADO_BOTAO	;SETA ESTADO_BOTAO P/ 1 HABILITANDO A TECLA_1
	MOVLW	0x31			;PASSA O VALOR 1 PARA W
	MOVWF	CAIXA			;PASSA O VALOR DE W PARA A VARIAVEL CAIXA
	CALL	CAIXA_LIVRE		;CHAMA A ESCRITA DE CAIXA LIVRE
	CALL	INTERRUPT		;CHAMA A INTERRUPCAO
	CALL	FILTRO			;DELAY
	CALL	FILTRO			;DELAY
	CALL	FILTRO			;DELAY
	CALL	FILTRO			;DELAY
	CALL	FILTRO			;DELAY
	CALL	FILTRO			;DELAY
	CALL	FILTRO			;DELAY
	CALL	FILTRO			;DELAY
	CALL	FILTRO			;DELAY
	CALL	FILTRO			;DELAY
	CALL	FILTRO			;DELAY
	CALL	FILTRO			;DELAY
	CALL	FILTRO			;DELAY
	BCF		PORTA,2			;DESLIGA O BUZZER
	
	RETURN					;RETORNA PARA A ROTINA PORT_C0

TECLA_1

	BTFSC	PORTB,1			;TESTA SE O BIT 1 DO PORTB ESTA COM VALOR 0
	RETURN					;RETORNA PARA A ROTINA PORT_C0
	CALL	FILTRO			;CHAMA A ROTINA FILTRO (DELAY)
	BTFSC	PORTB,1			;TESTA SE O BIT 1 DO PORTB ESTA COM VALOR 0
	RETURN					;RETORNA PARA A ROTINA PORT_C0
	CALL	FILTRO			;CHAMA A ROTINA FILTRO (DELAY)
	BTFSC	PORTB,1			;TESTA SE O BIT 1 DO PORTB ESTA COM VALOR 0
	RETURN					;RETORNA PARA A ROTINA PORT_C0
	BTFSS	PORTB,1			;VERIFICA SE O BOTAO FOI SOLTO
	GOTO	$-1				;EXECUTA A LINHA ANTERIOR NOVAMENTE

	BTFSS	ESTADO_BOTAO	;TESTA ESTADO_BOTAO
	RETURN					;RETORNA PARA A ROTINA PORT_C0

	INCF	CONTADOR		;INCREMENTA O CONTADOR DE PESSOAS
	MOVLW	0x31			;PASSA O VALOR 1 PARA W
	MOVWF	CAIXA			;PASSA O VALOR DE W PARA A VARIAVEL CAIXA
	CALL	CAIXA_FIM		;CHAMA A FINALIZAÇÃO DO ATENDIMENTO
	BCF		ESTADO_BOTAO	;LIMPA ESTADO_BOTAO, DESABILITANDO A TECLA_1
	BSF		FLAG_10S		;SETA A FLAG DE 10s
	BSF		ESTADO_MOTOR	;SETA A FLAG DE ESTADO DO MOTOR
	
	RETURN					;RETORNA PARA A ROTINA PORT_C0

TECLA_2
	
	BTFSC	PORTB,2			;TESTA SE O BIT 2 DO PORTB ESTA COM VALOR 0
	RETURN					;RETORNA PARA A ROTINA PORT_C0
	CALL	FILTRO			;CHAMA A ROTINA FILTRO (DELAY)
	BTFSC	PORTB,2			;TESTA SE O BIT 2 DO PORTB ESTA COM VALOR 0
	RETURN					;RETORNA PARA A ROTINA PORT_C0
	CALL	FILTRO			;CHAMA A ROTINA FILTRO (DELAY)
	BTFSC	PORTB,2			;TESTA SE O BIT 2 DO PORTB ESTA COM VALOR 0
	RETURN					;RETORNA PARA A ROTINA PORT_C0
	BTFSS	PORTB,2			;VERIFICA SE O BOTAO FOI SOLTO
	GOTO	$-1				;EXECUTA A LINHA ANTERIOR NOVAMENTE

	MOVF	CONTADOR,W		;MOVE CONTADOR P/ W
	MOVWF	BATATA			;MOVE W P/ BATATA
	CALL	DIGITOS			;CHAMA A ROTINA DE CALCULO DOS DIGITOS
	MOVLW	0x30			
	ADDWF	DIGITO1,F		;DEIXA EM ASCII			
	ADDWF	DIGITO2,F		;DEIXA EM ASCII			
	ADDWF	DIGITO3,F		;DEIXA EM ASCII
	CALL	MOSTRAR_CONTADOR;MOSTRA CONTADOR NO LCD
	
	RETURN					;RETORNA PARA A ROTINA PORT_C0

TECLA_3
	
	BTFSC	PORTB,3			;TESTA SE O BIT 3 DO PORTB ESTA COM VALOR 0
	RETURN					;RETORNA PARA A ROTINA PORT_C0
	CALL	FILTRO			;CHAMA A ROTINA FILTRO (DELAY)
	BTFSC	PORTB,3			;TESTA SE O BIT 3 DO PORTB ESTA COM VALOR 0
	RETURN					;RETORNA PARA A ROTINA PORT_C0
	CALL	FILTRO			;CHAMA A ROTINA FILTRO (DELAY)
	BTFSC	PORTB,3			;TESTA SE O BIT 3 DO PORTB ESTA COM VALOR 0
	RETURN					;RETORNA PARA A ROTINA PORT_C0
	BTFSS	PORTB,3			;VERIFICA SE O BOTAO FOI SOLTO
	GOTO	$-1				;EXECUTA A LINHA ANTERIOR NOVAMENTE

	BTFSS	ESTADO_E2PROM	;TESTA A FLAG, SE ENDERECO SETADO EXECUTA
	RETURN	

	CALL	ESCR_E2PROM		;VAI PARA A ROTINA DE ESCRITA DA E2PROM
	CALL	FIM_ESCRITA		;ROTINA DE FIM DA ESCRITA NA E2PROM
	BCF		ESTADO_E2PROM	;LIMPA A FLAG
	
	RETURN					;RETORNA PARA A ROTINA PORT_C0

TECLA_8
	
	BTFSC	PORTB,0			;TESTA SE O BIT 0 DO PORTB ESTA COM VALOR 0
	RETURN					;RETORNA PARA A ROTINA PORT_C2
	CALL	FILTRO			;CHAMA A ROTINA FILTRO (DELAY)
	BTFSC	PORTB,0			;TESTA SE O BIT 0 DO PORTB ESTA COM VALOR 0
	RETURN					;RETORNA PARA A ROTINA PORT_C2
	CALL	FILTRO			;CHAMA A ROTINA FILTRO (DELAY)
	BTFSC	PORTB,0			;TESTA SE O BIT 0 DO PORTB ESTA COM VALOR 0
	RETURN					;RETORNA PARA A ROTINA PORT_C2
	BTFSS	PORTB,0			;VERIFICA SE O BOTAO FOI SOLTO
	GOTO	$-1				;EXECUTA A LINHA ANTERIOR NOVAMENTE

	MOVLW	0x00			;SETA O VALOR 0x01
	MOVWF	ENDERECO		;MOVE ESSE VALOR PARA A VARIAVEL ENDERECO
	CALL	MOSTRAR_ENDERECO;CHAMA A ROTINA DE MOSTRAR ENDERECO
	BSF		ESTADO_E2PROM	;SETA A FLAG DA E2PROM
	
	RETURN					;RETORNA PARA A ROTINA PORT_C2

TECLA_9

	BTFSC	PORTB,1			;TESTA SE O BIT 1 DO PORTB ESTA COM VALOR 0
	RETURN					;RETORNA PARA A ROTINA PORT_C2
	CALL	FILTRO			;CHAMA A ROTINA FILTRO (DELAY)
	BTFSC	PORTB,1			;TESTA SE O BIT 1 DO PORTB ESTA COM VALOR 0
	RETURN					;RETORNA PARA A ROTINA PORT_C2
	CALL	FILTRO			;CHAMA A ROTINA FILTRO (DELAY)
	BTFSC	PORTB,1			;TESTA SE O BIT 1 DO PORTB ESTA COM VALOR 0
	RETURN					;RETORNA PARA A ROTINA PORT_C2
	BTFSS	PORTB,1			;VERIFICA SE O BOTAO FOI SOLTO
	GOTO	$-1				;EXECUTA A LINHA ANTERIOR NOVAMENTE

	MOVLW	0x01			;SETA O VALOR 0x01
	MOVWF	ENDERECO		;MOVE ESSE VALOR PARA A VARIAVEL ENDERECO
	CALL	MOSTRAR_ENDERECO;CHAMA A ROTINA DE MOSTRAR ENDERECO
	BSF		ESTADO_E2PROM	;SETA A FLAG DA E2PROM
	
	RETURN					;RETORNA PARA A ROTINA PORT_C2

TECLA_A
	
	BTFSC	PORTB,2			;TESTA SE O BIT 2 DO PORTB ESTA COM VALOR 0
	RETURN					;RETORNA PARA A ROTINA PORT_C2
	CALL	FILTRO			;CHAMA A ROTINA FILTRO (DELAY)
	BTFSC	PORTB,2			;TESTA SE O BIT 2 DO PORTB ESTA COM VALOR 0
	RETURN					;RETORNA PARA A ROTINA PORT_C2
	CALL	FILTRO			;CHAMA A ROTINA FILTRO (DELAY)
	BTFSC	PORTB,2			;TESTA SE O BIT 2 DO PORTB ESTA COM VALOR 0
	RETURN					;RETORNA PARA A ROTINA PORT_C2
	BTFSS	PORTB,2			;VERIFICA SE O BOTAO FOI SOLTO
	GOTO	$-1				;EXECUTA A LINHA ANTERIOR NOVAMENTE

	MOVLW	0x02			;SETA O VALOR 0x01
	MOVWF	ENDERECO		;MOVE ESSE VALOR PARA A VARIAVEL ENDERECO
	CALL	MOSTRAR_ENDERECO;CHAMA A ROTINA DE MOSTRAR ENDERECO
	BSF		ESTADO_E2PROM	;SETA A FLAG DA E2PROM
	
	RETURN					;RETORNA PARA A ROTINA PORT_C2

TECLA_B

	BTFSC	PORTB,3			;TESTA SE O BIT 3 DO PORTB ESTA COM VALOR 0
	RETURN					;RETORNA PARA A ROTINA PORT_C2
	CALL	FILTRO			;CHAMA A ROTINA FILTRO (DELAY)
	BTFSC	PORTB,3			;TESTA SE O BIT 3 DO PORTB ESTA COM VALOR 0
	RETURN					;RETORNA PARA A ROTINA PORT_C2
	CALL	FILTRO			;CHAMA A ROTINA FILTRO (DELAY)
	BTFSC	PORTB,3			;TESTA SE O BIT 3 DO PORTB ESTA COM VALOR 0
	RETURN					;RETORNA PARA A ROTINA PORT_C2
	BTFSS	PORTB,3			;VERIFICA SE O BOTAO FOI SOLTO
	GOTO	$-1				;EXECUTA A LINHA ANTERIOR NOVAMENTE

	BTFSS	ESTADO_E2PROM	;TESTA A FLAG, SE ENDERECO SETADO EXECUTA
	RETURN	

	CALL	LEIT_E2PROM		;INICIA A LEITURA DA E2PROM
	MOVF	DADO,W			;MOVE DADO P/ W
	MOVWF	BATATA			;MOVE W P/ BATATA
	CALL	DIGITOS			;CHAMA A ROTINA DE CALCULO DOS DIGITOS
	MOVLW	0x30			;MOVE O VALOR 0 P/ ASCII
	ADDWF	DIGITO1,F		;DEIXA EM ASCII			
	ADDWF	DIGITO2,F		;DEIXA EM ASCII			
	ADDWF	DIGITO3,F		;DEIXA EM ASCII
	CALL	MOSTRAR_CONTADOR;CHAMA A ROTINA DE CALCULO DOS DIGITOS E MOSTRA CONTADOR NO LCD
	BCF		ESTADO_E2PROM	;LIMPA A FLAG
	
	RETURN					;RETORNA PARA A ROTINA PORT_C2

TECLA_C

	BTFSC	PORTB,0			;TESTA SE O BIT 0 DO PORTB ESTA COM VALOR 0
	RETURN					;RETORNA PARA A ROTINA PORT_C3
	CALL	FILTRO			;CHAMA A ROTINA FILTRO (DELAY)
	BTFSC	PORTB,0			;TESTA SE O BIT 0 DO PORTB ESTA COM VALOR 0
	RETURN					;RETORNA PARA A ROTINA PORT_C3
	CALL	FILTRO			;CHAMA A ROTINA FILTRO (DELAY)
	BTFSC	PORTB,0			;TESTA SE O BIT 0 DO PORTB ESTA COM VALOR 0
	RETURN					;RETORNA PARA A ROTINA PORT_C3
	BTFSS	PORTB,0			;VERIFICA SE O BOTAO FOI SOLTO
	GOTO	$-1				;EXECUTA A LINHA ANTERIOR NOVAMENTE

	BTFSC	ESTADO_MOTOR	;TRAVA DE MOTOR LIGADO
	RETURN					;RETORNA

	BTFSS	ESTADO_BOTAO	;TRAVA DE NAO ATENDIMENTO
	RETURN					;RETORNA

	MOVLW	B'01011001'		;VELOCIDADE DESEJADA DE 35%
	MOVWF	CCPR2L			;MOVE W P/ O REGISTRADOR CCPR2L

	BSF		CCP2CON,4		;SETA CCP2CON BIT 4 P/ VELOCIDADE DESEJADA DE 35%
	BSF		CCP2CON,5		;SETA CCP2CON BIT 5 P/ VELOCIDADE DESEJADA DE 35%

	BSF		PORTB,4			;LIGANDO O MOTOR
	BCF		PORTB,5			;LIGANDO O MOTOR

	CALL	INTERRUPT		;CHAMA A INTERRUPCAO
	CALL	MOSTRAR_V33		;CHAMA O DISPLAY

	BSF		ESTADO_MOTOR	;SETA A VARIAVEL DE TRAVA DO MOTOR
	
	RETURN					;RETORNA PARA A ROTINA PORT_C3

TECLA_D

	BTFSC	PORTB,1			;TESTA SE O BIT 1 DO PORTB ESTA COM VALOR 0
	RETURN					;RETORNA PARA A ROTINA PORT_C3
	CALL	FILTRO			;CHAMA A ROTINA FILTRO (DELAY)
	BTFSC	PORTB,1			;TESTA SE O BIT 1 DO PORTB ESTA COM VALOR 0
	RETURN					;RETORNA PARA A ROTINA PORT_C3
	CALL	FILTRO			;CHAMA A ROTINA FILTRO (DELAY)
	BTFSC	PORTB,1			;TESTA SE O BIT 1 DO PORTB ESTA COM VALOR 0
	RETURN					;RETORNA PARA A ROTINA PORT_C3
	BTFSS	PORTB,1			;VERIFICA SE O BOTAO FOI SOLTO
	GOTO	$-1				;EXECUTA A LINHA ANTERIOR NOVAMENTE

	BTFSC	ESTADO_MOTOR	;TRAVA DE MOTOR LIGADO
	RETURN					;RETORNA

	BTFSS	ESTADO_BOTAO	;TRAVA DE NAO ATENDIMENTO
	RETURN					;RETORNA

	MOVLW	B'11111111'		;VELOCIDADE DESEJADA DE 100%
	MOVWF	CCPR2L			;MOVE W P/ O REGISTRADOR CCPR2L

	BSF		CCP2CON,4		;SETA CCP2CON BIT 4 P/ VELOCIDADE DESEJADA DE 100%
	BSF		CCP2CON,5		;SETA CCP2CON BIT 5 P/ VELOCIDADE DESEJADA DE 100%	

	BSF		PORTB,4			;LIGA O MOTOR
	BCF		PORTB,5			;LIGA O MOTOR

	CALL	INTERRUPT		;CHAMA A INTERRUPCAO
	CALL	MOSTRAR_V100	;CHAMA O DISPLAY

	BSF		ESTADO_MOTOR	;SETA A VARIAVEL DE TRAVA DO MOTOR
	
	RETURN					;RETORNA PARA A ROTINA PORT_C3

TECLA_E

	BTFSC	PORTB,2			;TESTA SE O BIT 2 DO PORTB ESTA COM VALOR 0
	RETURN					;RETORNA PARA A ROTINA PORT_C3
	CALL	FILTRO			;CHAMA A ROTINA FILTRO (DELAY)
	BTFSC	PORTB,2			;TESTA SE O BIT 2 DO PORTB ESTA COM VALOR 0
	RETURN					;RETORNA PARA A ROTINA PORT_C3
	CALL	FILTRO			;CHAMA A ROTINA FILTRO (DELAY)
	BTFSC	PORTB,2			;TESTA SE O BIT 2 DO PORTB ESTA COM VALOR 0
	RETURN					;RETORNA PARA A ROTINA PORT_C3
	BTFSS	PORTB,2			;VERIFICA SE O BOTAO FOI SOLTO
	GOTO	$-1				;EXECUTA A LINHA ANTERIOR NOVAMENTE

	BCF		FIM_MEDIA		;LIMPA A FLAG DE CONTROLE DO CODIGO
	BCF		RESTO_0			;LIMPA A FLAG DE CONTROLE DAS CASAS DECIMAIS
	CALL	CALCULO_MEDIA	;CHAMA A ROTINA PARA CALCULO DA MEDIA
	MOVF	MEDIA,W			;MOVE O VALOR DE MEDIA P/ W
	MOVWF	BATATA			;MOVE O VALOR DE W P/ A VARIAVEL DA ROTINA BATATA
	CALL	DIGITOS			;CHAMA A ROTINA DIGITOS

	MOVF	MEDIA_RESTO,W	;MOVE O VALOR DE MEDIA_RESTO P/ W
	XORLW	0x00			;FAZ UM "OU EXCLUSIVO" DE 0 COM O VALOR DE MEDIA_RESTO
	BTFSC	STATUS,2		;TESTA SE O STATUS Z FOI AFETADO, SE 1 O VALOR DE MEDIA_RESTO É IGUAL 0
	BSF		RESTO_0			;SE MEDIA_RESTO IGUAL A 0, SETA A FLAG DE CONTROLE DA CASA DECIMAL

	MOVF	DIGITO1,W		;MOVE O VALOR DE DIGITO1 P/ W
	XORLW	0x00			;FAZ UM "OU EXCLUSIVO" DE 0 COM O VALOR DE DIGITO1
	BTFSS	STATUS,2		;TESTA SE O STATUS Z FOI AFETADO, SE 1 O VALOR DE DIGITO1 É IGUAL A 0
	CALL	MOSTRAR_MEDIA_3CASAS	;CHAMA A ROTINA QUE MOSTRA A MEDIA COM TRÊS CASAS INTEIRAS
	
	BTFSC	FIM_MEDIA		;TESTA A FLAG FIM_MEDIA P/ SABER SE A ROTINA JÁ ESCREVEU ALGO NO LCD
	RETURN					;RETORNA
	
	MOVF	DIGITO2,W		;MOVE O VALOR DE DIGITO2 P/ W
	XORLW	0x00			;FAZ UM "OU EXCLUSIVO" DE 0 COM O VALOR DE DIGITO2
	BTFSS	STATUS,2		;TESTA SE O STATUS Z FOI AFETADO, SE 1 O VALOR DE DIGITO2 É IGUAL A 0
	CALL	MOSTRAR_MEDIA_2CASAS	;CHAMA A ROTINA QUE MOSTRA A MEDIA COM DUAS CASAS INTEIRAS
	
	BTFSC	FIM_MEDIA		;TESTA A FLAG FIM_MEDIA P/ SABER SE A ROTINA JÁ ESCREVEU ALGO NO LCD
	RETURN					;RETORNA

	CALL	MOSTRAR_MEDIA_1CASA		;CHAMA A ROTINA QUE MOSTRA A MEDIA COM UMA CASA INTEIRA

	RETURN					;RETORNA PARA A ROTINA PORT_C3

TECLA_F
	
	BTFSC	PORTB,3			;TESTA SE O BIT 3 DO PORTB ESTA COM VALOR 0
	RETURN					;RETORNA PARA A ROTINA PORT_C3
	CALL	FILTRO			;CHAMA A ROTINA FILTRO (DELAY)
	BTFSC	PORTB,3			;TESTA SE O BIT 3 DO PORTB ESTA COM VALOR 0
	RETURN					;RETORNA PARA A ROTINA PORT_C3
	CALL	FILTRO			;CHAMA A ROTINA FILTRO (DELAY)
	BTFSC	PORTB,3			;TESTA SE O BIT 3 DO PORTB ESTA COM VALOR 0
	RETURN					;RETORNA PARA A ROTINA PORT_C3
	BTFSS	PORTB,3			;VERIFICA SE O BOTAO FOI SOLTO
	GOTO	$-1				;EXECUTA A LINHA ANTERIOR NOVAMENTE

	MOVLW	0x00			;VALOR 0
	MOVWF	CONTADOR		;ZERA O CONTADOR
	CALL	INICIALIZA_LCD	;INDICADOR QUE ZEROU
	BCF		ESTADO_BOTAO	;LIMPA ESTADO_BOTAO, DESABILITANDO A TECLA_1
	BSF		FLAG_10S		;SETA A FLAG DE 10s
	BSF		ESTADO_MOTOR	;SETA A FLAG DE ESTADO DO MOTOR

	
	RETURN					;RETORNA PARA A ROTINA PORT_C3